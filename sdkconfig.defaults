## sdkconfig.defaults
```kconfig
# Target ESP32-C3
CONFIG_IDF_TARGET="esp32c3"

# Flash settings
CONFIG_ESPTOOLPY_FLASHSIZE_4MB=y
CONFIG_ESPTOOLPY_FLASHMODE_DIO=y
CONFIG_ESPTOOLPY_FLASHFREQ_80M=y

# FreeRTOS & System Stack
CONFIG_ESP_MAIN_TASK_STACK_SIZE=8192
CONFIG_ESP_SYSTEM_EVENT_TASK_STACK_SIZE=4096

# HTTP Server buffer
CONFIG_HTTPD_MAX_REQ_HDR_LEN=1024
CONFIG_HTTPD_MAX_URI_LEN=512

# lwIP & WiFi
CONFIG_LWIP_MAX_SOCKETS=10
CONFIG_ESP32_WIFI_STATIC_RX_BUFFER_NUM=10
CONFIG_ESP32_WIFI_DYNAMIC_RX_BUFFER_NUM=32
CONFIG_ESP32_WIFI_TX_BUFFER_TYPE_1=y
CONFIG_ESP32_WIFI_STATIC_TX_BUFFER_NUM=16
```
